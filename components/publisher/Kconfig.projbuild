## components/publisher/Kconfig.projbuild
```kconfig
menu "Publisher Configuration"
    config PUBLISHER_WIFI_SSID
        string "Publisher: WiFi SSID"
        default "VogonMothership"

    config PUBLISHER_WIFI_PASSWORD
        string "Publisher: WiFi Password"
        default "DontPanic!42"

    config PUBLISHER_MQTT_BROKER
        string "Publisher: MQTT broker"
        default "mqtt://192.168.0.1"

    config PUBLISHER_DEVICE_MANUFACTURER_NAME
        string "Publisher: BLE manufacture name of the IoT nodes (serves also as protocol version)"
        default "VOG1"
endmenu
```
